## experimental/u30air-charge2/source/upstream/u30air/typec/drivers/usb/typec/Kconfig
```kconfig
config USB_SC27XX_TYPEC
	tristate "Unisoc SC27xx/UMP96xx USB Type-C controller"
	depends on TYPEC && EXTCON && NVMEM
	depends on MFD_SC27XX_PMIC || COMPILE_TEST
	depends on SPRD_TYPEC_TCPM
	help
	  Type-C attach detection and extcon role reporting for Unisoc PMICs,
	  including the UMP9620 used by the ZTE U30 Air.
```

## upstream/u30air/typec/drivers/usb/typec/tcpm/Kconfig
```kconfig
config SPRD_TYPEC_TCPM
	tristate "Unisoc USB Type-C and Power Delivery policy manager"
	depends on USB && TYPEC
	select USB_ROLE_SWITCH
	select POWER_SUPPLY
	help
	  Type-C and USB Power Delivery policy manager used by Unisoc
	  SC27xx/UMP96xx controllers.

config SC27XX_PD
	tristate "Unisoc SC27xx/UMP96xx USB Power Delivery controller"
	depends on SPRD_TYPEC_TCPM && EXTCON && REGULATOR && NVMEM
	depends on MFD_SC27XX_PMIC || COMPILE_TEST
	select MFD_SYSCON
	help
	  USB Power Delivery controller for the UMP9620 and related PMICs.
```
